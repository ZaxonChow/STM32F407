#include "./modbus_rtu/bsp_master.h"

// CRC校验
//********************************************************************************************************************
const uint8_t auchCRCHi[] = { 
0x00, 0xC1, 0x81, 0x40, 0x01, 0xC0, 0x80, 0x41, 0x01, 0xC0,0x80, 0x41, 0x00, 0xC1, 0x81, 0x40, 0x01, 0xC0, 0x80, 0x41, 
0x00, 0xC1, 0x81, 0x40, 0x00, 0xC1, 0x81, 0x40, 0x01, 0xC0,0x80, 0x41, 0x01, 0xC0, 0x80, 0x41, 0x00, 0xC1, 0x81, 0x40, 
0x00, 0xC1, 0x81, 0x40, 0x01, 0xC0, 0x80, 0x41, 0x00, 0xC1,0x81, 0x40, 0x01, 0xC0, 0x80, 0x41, 0x01, 0xC0, 0x80, 0x41, 
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0x8F, 0xF9, 0x41, 0x79, 0xFA}; 

const uint8_t auchCRCLo[] = { 
0x00, 0xC0, 0xC1, 0x01, 0xC3, 0x03, 0x02, 0xC2, 0xC6, 0x06,0x07, 0xC7, 0x05, 0xC5, 0xC4, 0x04, 0xCC, 0x0C, 0x0D, 0xCD, 
0x0F, 0xCF, 0xCE, 0x0E, 0x0A, 0xCA, 0xCB, 0x0B, 0xC9, 0x09,0x08, 0xC8, 0xD8, 0x18, 0x19, 0xD9, 0x1B, 0xDB, 0xDA, 0x1A, 
0x1E, 0xDE, 0xDF, 0x1F, 0xDD, 0x1D, 0x1C, 0xDC, 0x14, 0xD4,0xD5, 0x15, 0xD7, 0x17, 0x16, 0xD6, 0xD2, 0x12, 0x13, 0xD3, 
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0x8F, 0x41, 0xF9, 0x79, 0xFA};
//********************************************************************************************************************

/* 溶解氧读测量值指令
	*设备ID地址：0x01
	*功能码：0x03
	*寄存器起始地址：0x0001
	*寄存器数量：0x0002
	*CRC16：0xCB95	
*/
Command Ox_ReadValCmd = {0x01, 0x03, 0x00, 0x01, 0x00, 0x02, 0x95, 0xCB};

/* PH读测量值指令
	*设备ID地址：0x02
	*功能码：0x03
	*寄存器起始地址：0x0001
	*寄存器数量：0x0002
	*CRC16：0xF895	
*/
Command PH_ReadValCmd = {0x02, 0x03, 0x00, 0x01, 0x00, 0x02, 0x95, 0xF8};


uint8_t  RS485_RxFlag;
uint32_t RS485_RX_BUFF[20];		//接收缓冲区2048字节
uint16_t RS485_RX_CNT;

uint8_t  RS485_TX_BUFF[20];		//发送缓冲区
uint16_t RS485_TX_CNT = 0;		//发送计数器
uint8_t  RS485_TxFlag = 0;		//发送一帧结束标记

uint8_t State = 1;				//当前读取的传感器，1表示溶解氧，2表示PH,先读溶解氧
uint8_t OX_State = 1;			//溶解氧传感器接收使能控制：0 - 关闭，1 - 接收
uint8_t PH_State = 0;			//PH传感器接收使能控制：0 - 关闭，1 - 接收

/* CRC校验函数 */
//static uint16_t CRC_Compute(uint8_t* puchMsg, uint16_t usDataLen)
//{ 
//	uint8_t uchCRCHi = 0xFF ; 
//	uint8_t uchCRCLo = 0xFF ; 
//	uint32_t uIndex ; 
//	while(usDataLen--) 
//	{ 
//		uIndex = uchCRCHi ^ *puchMsg++ ; 
//		uchCRCHi = uchCRCLo ^ auchCRCHi[uIndex] ; 
//		uchCRCLo = auchCRCLo[uIndex] ; 
//	}
//	return ((uchCRCHi << 8)  | (uchCRCLo)) ; 
//}

/* 主机读测量值服务程序
	*根据设备ID地址，读取相应的检测数据
*/
void ReadVal_Service(uint8_t SlaverAddr)
{    
	switch(SlaverAddr)
	{
		case 01://读溶解氧
				Read_Val(&Ox_ReadValCmd);
				break;
		case 02://读pH值
				Read_Val(&PH_ReadValCmd);
				break;
	}		
}

/* 向传感器发送读测量值指令 */
static void Read_Val(Command* Read_VAL_Cmd)
{ 
	RS485_TX_BUFF[0] = Read_VAL_Cmd->SlaverAddr;
	RS485_TX_BUFF[1] = Read_VAL_Cmd->FuctionNum;
	RS485_TX_BUFF[2] = Read_VAL_Cmd->AddrH;  
	RS485_TX_BUFF[3] = Read_VAL_Cmd->AddrL; 
	RS485_TX_BUFF[4] = Read_VAL_Cmd->QuantityH;
	RS485_TX_BUFF[5] = Read_VAL_Cmd->QuantityL;
	RS485_TX_BUFF[6] = Read_VAL_Cmd->CRCL;
	RS485_TX_BUFF[7] = Read_VAL_Cmd->CRCH;
	RS485_SendData(&RS485_TX_BUFF[0], 8);		//发送读测量值指令
}

/* 接收数据处理函数
	*根据从机设备 ID 地址，处理从机返回的数据
*/
void Receive_Service(void)
{
	//uint16_t calCRC = 0;	//存放接收数据计算后得到的 CRC 校验值
	//uint16_t recCRC;		//存放接收到的 CRC 校验值
	
	if(RS485_RxFlag == 1 &&							//确认接收一帧数据
		RS485_RX_BUFF[0] == RS485_TX_BUFF[0] &&		//地址正确
		RS485_RX_BUFF[1] == RS485_TX_BUFF[1])		//功能码正确
	{
		//CRC校验
		//calCRC = CRC_Compute(RS485_RX_BUFF, RS485_RX_CNT - 2);	//计算所接收数据的CRC
		//recCRC = RS485_RX_BUFF[RS485_RX_CNT-1] | (((uint16_t)RS485_RX_BUFF[RS485_RX_CNT-2]) << 8);//接收到的CRC(低字节在前，高字节在后)
		//if(calCRC == recCRC)//CRC校验正确
		//{
			switch(RS485_RX_BUFF[0])	//根据不同的设备 ID 地址进行处理
			{    
				case 01:
					Modbus_OX_Solve();
					break;
				case 02:
					Modbus_PH_Solve();
					break;
			}													
		//}
	}                              
	RS485_RxFlag = 0;		//复位帧结束标志
	RS485_RX_CNT = 0;		//接收计数器清零
	_485_TX_EN();			//接收完成，开启发送模式  
}

/* 处理溶解氧传感器返回的数据
	*排除了寄存器的字节验证机制，采用默认的轮询周期清空缓存区
*/
void Modbus_OX_Solve(void)
{
	float Ox_Value;
	uint32_t temp[1] = { 0 };
	uint32_t OX = 0;
	if(RS485_RxFlag)	//接收到了数据,且接收完成了
	{			
		RS485_RX_CNT = 0;	//清零接收数据计数
		//溶解氧
		temp[0] = ((RS485_RX_BUFF[5] << 24) | (RS485_RX_BUFF[6] << 16) | (RS485_RX_BUFF[3] << 8) | RS485_RX_BUFF[4]);
		//printf("%2x %2x %2x %2x \r\n", RS485_RX_BUFF[5], RS485_RX_BUFF[6], RS485_RX_BUFF[3], RS485_RX_BUFF[4]);
		Ox_Value = *((float*)&temp[0]);
		//printf("\r\nOX_Value = %.2f mg/L\r\n", Ox_Value);
		OX = (int)(Ox_Value * 100.00);
		TJCPrintf("page0.x2.val=%d\xff\xff\xff\r\n", OX);	//显示溶解氧
	}
}

/* 处理PH传感器返回的数据
	*排除了寄存器的字节验证机制，采用默认的轮询周期清空缓存区
*/
void Modbus_PH_Solve(void)
{
	float PH_Value;
	uint32_t temp[1] = { 0 };
	uint32_t PH = 0;
	//mx=*((float*)&xbuf[0])
	if(RS485_RxFlag)	//接收到了数据,且接收完成了
	{			
		RS485_RX_CNT = 0;	//清零接收数据计数
		//溶解氧
		temp[0] = ((RS485_RX_BUFF[5] << 24) | (RS485_RX_BUFF[6] << 16) | (RS485_RX_BUFF[3] << 8) | RS485_RX_BUFF[4]);
		//printf("%2x %2x %2x %2x \r\n", RS485_RX_BUFF[5], RS485_RX_BUFF[6], RS485_RX_BUFF[3], RS485_RX_BUFF[4]);
		PH_Value = *((float*)&temp[0]);
		//printf("PH_Value = %.2f\r\n", PH_Value);
		PH = (int)(PH_Value * 100.00);
		TJCPrintf("page0.x1.val=%d\xff\xff\xff\r\n", PH);//显示PH
		Usart_SendString(USART6, AT_T);
	}
}

//通讯策略
void Modbus_RTU(void)   //TIM4 中断调用的
{	
	switch(State)		//根据模式，选择读取数据类型
	{
		case 1: //modbus执行命令第一步。
				//向从机发送一个请求。发送命令完成，定时器T4处理接收到的数据
			if(OX_State == 1)
			{
				ReadVal_Service(0x01);	//发送指令读取溶解氧
				OX_State = 0;
				State = 2;				//切换到ph值传感器
				PH_State = 1;
			}
			break;
		case 2:
			if(PH_State == 1)
			{
				ReadVal_Service(0x02);	//发送指令读取PH值
				PH_State = 0;
				State = 1;				//切换到溶解氧传感器
				OX_State = 1;
			}
			break;
	}
}



